## components/wifi_mgr/Kconfig
```kconfig
menu "Sensor-Actor WiFi"

    config SA_WIFI_TEST_TIMING
        bool "Short WiFi retry timers (testing only)"
        default n
        help
            Replaces the FSD timing (10 s for 5 min, 5 min for 1 h, AP retry every 15 min)
            with 2 s for 20 s, 10 s for 40 s, AP retry every 30 s, so the reconnect and
            access-point fallback can be tested on the bench in about a minute.

endmenu
```

## main/Kconfig.projbuild
```kconfig
menu "Sensor-Actor test options"

    config SA_TEST_BROKEN_FIRMWARE
        bool "Test only: firmware that fails its self-check"
        default n
        help
            Builds a firmware that restarts 5 s after boot without confirming itself.
            Installed via OTA, the bootloader must roll back to the previous firmware.
            Used to test REQ-OTA-2; never enable in a real build.

endmenu
```
